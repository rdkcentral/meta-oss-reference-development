## conf/layer.conf
```bitbake
# We have a conf and classes directory, add to BBPATH
BBPATH .= ":${LAYERDIR}"

# We have recipes-* directories, add to BBFILES
BBFILES += "${LAYERDIR}/recipes-*/*/*.bb \
            ${LAYERDIR}/recipes-*/*/*.bbappend"

BBFILE_COLLECTIONS += "oss-development"
BBFILE_PATTERN_oss-development = "^${LAYERDIR}/"
BBFILE_PRIORITY_oss-development = "6"

LAYERDEPENDS_oss-development = "core"
LAYERSERIES_COMPAT_oss-development = "dunfell kirkstone"
```

## conf/machine/include/oss.inc
```bitbake
DISTRO_VERSION = "2.0"
DISTRO_NAME="RDK (A Yocto Project based Distro)"
TARGET_VENDOR = "-rdk"

#Mirror configurations
PREMIRRORS ?= "\
bzr://.*/.*   http://96.118.132.221/pub/sources/ \n \
cvs://.*/.*   http://96.118.132.221/pub/sources/ \n \
git://.*/.*   http://96.118.132.221/pub/sources/ \n \
hg://.*/.*    http://96.118.132.221/pub/sources/ \n \
osc://.*/.*   http://96.118.132.221/pub/sources/ \n \
p4://.*/.*    http://96.118.132.221/pub/sources/ \n \
svn://.*/.*   http://96.118.132.221/pub/sources/ \n"

MIRRORS =+ "\
ftp://.*/.*      http://96.118.132.221/pub/sources/ \n \
http://.*/.*     http://96.118.132.221/pub/sources/ \n \
https://.*/.*    http://96.118.132.221/pub/sources/ \n"


BB_DANGLINGAPPENDS_WARNONLY = "true"

TCLIBCAPPEND = ""

DISTRO_FEATURES_BACKFILL_CONSIDERED += "pulseaudio"
DISTRO_FEATURES_BACKFILL_CONSIDERED += "gobject-introspection-data"
DISTRO_FEATURES_BACKFILL_CONSIDERED += "ldconfig"

DISTRO_FEATURES:append = " gobject-introspection-data"

PREFERRED_PROVIDER_virtual/kernel = ""

# Disable layer consumption for oss layer
USER_CLASSES:remove = "base-deps-resolver"
```

## conf/machine/include/ptest.inc
```bitbake
# Global: Enable ptest framework for all packages
PTEST_ENABLED = "${@bb.utils.contains('DISTRO_FEATURES', 'ptest', '1', '', d)}"

# Image content: What to include in the image (when ptest enabled)
EXTRA_IMAGE_FEATURES:append = "${@bb.utils.contains('DISTRO_FEATURES', 'ptest', ' ptest-pkgs', '', d)}"

# For the following recipes enabling ptest results in failure so removed them will work on enabling in upcoming releases
IMAGE_INSTALL:remove = "${@bb.utils.contains('DISTRO_FEATURES', 'ptest', ' gdbm-ptest pango-ptest bluez5-ptest findutils-ptest lttng-tools-ptest', '', d)}"
PTEST_ENABLED:pn-bluez5 = "0"

# License policy: What licenses are acceptable in this build
LICENSE_FLAGS_ACCEPTED:append = "${@bb.utils.contains('DISTRO_FEATURES', 'ptest', ' GPL-3.0-only GPL-3.0-or-later', '', d)}"
INCOMPATIBLE_LICENSE:remove = "${@bb.utils.contains('DISTRO_FEATURES', 'ptest', ' GPL-3.0-only LGPL-3.0-only LGPL-3.0-or-later GPL-3.0-or-later', '', d)}"

# To supress compilation error in glibc-tests when ptest is enabled
CFLAGS:append:pn-glibc-tests = "${@bb.utils.contains('DISTRO_FEATURES', 'ptest', ' -Wno-error=format-overflow', '', d)}"

# Version preferences, lower versions doesn't have ptest support
PREFERRED_VERSION_gmp = "${@bb.utils.contains('DISTRO_FEATURES', 'ptest', '6.2.1', '', d)}"
PREFERRED_VERSION_coreutils = "${@bb.utils.contains('DISTRO_FEATURES', 'ptest', '9.0', '', d)}"
PREFERRED_VERSION_m4 = "${@bb.utils.contains('DISTRO_FEATURES', 'ptest', '1.4.19', '', d)}"
BBMASK:append = "${@bb.utils.contains('DISTRO_FEATURES', 'ptest', ' meta-rdk-oss-reference/recipes-gplv2/gettext/gettext_0.16.1.bb ', '', d)}"

# Adding components for which ptest support is newly added
PTESTS_FAST:append = " alsa-lib-ptest \
                libatomic-ops-ptest \
                libcheck-ptest \
                xz-ptest \
                libcap-ptest \
                kbd-ptest \
                file-ptest \
                zstd-ptest \
                attr-ptest \
                grep-ptest \
                curl-ptest \
                make-ptest \
                libpcap-ptest \
                apr-util-ptest \
                libxslt-ptest \
                lz4-ptest \
                gmp-ptest \
                opkg-utils-ptest \
              "
```

## conf/machine/rdk-arm64.conf
```bitbake
#TYPE: Machine
#@NAME: rdk-arm64
#@NEEDED_BSPLAYERS: rdke/common/meta-oss-reference-development
#@DESCRIPTION: rdk arm64 arch specific oss machine
#



require conf/multilib.conf
MULTILIBS = "multilib:lib32"
DEFAULTTUNE:virtclass-multilib-lib32 = "armv7vethf-neon"

MACHINEOVERRIDES .= ":mixmode"
DISTRO_FEATURES:append = " mixmode"


# To set DEFAULTTUNE = "armv7vethf-neon"
require conf/machine/include/arm/arch-armv8a.inc

# configs shared across rdke layers
require conf/rdke-config.inc

LINUXLIBCVERSION = "5.4%"

#Machine overrides
MACHINEOVERRIDES .= ":kirkstone"
MACHINEOVERRIDES .= ":client:rdkzram"

#Distro features
DISTRO_FEATURES:append = " systemd kirkstone"

DISTRO_FEATURES_BACKFILL_CONSIDERED += "sysvinit"
VIRTUAL-RUNTIME_init_manager ?= "systemd"
VIRTUAL-RUNTIME_initscripts ?= "systemd-compat-units"

#OSS includes
include conf/machine/include/oss.inc
include conf/include/oss-config.inc

#ptest include
include ${@bb.utils.contains('DISTRO_FEATURES', 'ptest', 'conf/machine/include/ptest.inc', '', d)}
```

## conf/machine/rdk-arm7a.conf
```bitbake
#TYPE: Machine
#@NAME: rdk-arm
#@NEEDED_BSPLAYERS: rdke/common/meta-oss-reference-development
#@DESCRIPTION: rdk arm arch specific oss machine
#



DEFAULTTUNE = "armv7athf-neon"
require conf/machine/include/arm/arch-arm64.inc
# configs shared across rdke layers
require conf/rdke-config.inc
LINUXLIBCVERSION = "6.6%"

#Machine overrides
MACHINEOVERRIDES .= ":arm"
MACHINEOVERRIDES .= ":scarthgap"
MACHINEOVERRIDES .= ":client:rdkzram"

#Distro features
DISTRO_FEATURES:append = " systemd"

DISTRO_FEATURES_BACKFILL_CONSIDERED += "sysvinit"
VIRTUAL-RUNTIME_init_manager ?= "systemd"
VIRTUAL-RUNTIME_initscripts ?= "systemd-compat-units"

#OSS includes
include conf/machine/include/oss.inc
include conf/include/oss-config.inc
```

## conf/machine/rdk-arm7ve.conf
```bitbake
#TYPE: Machine
#@NAME: rdk-arm7ve
#@NEEDED_BSPLAYERS: rdke/common/meta-oss-reference-development
#@DESCRIPTION: rdk arm7ve arch specific oss machine
#



DEFAULTTUNE = "armv7vethf-neon"
require conf/machine/include/arm/armv7a/tune-cortexa15.inc

# configs shared across rdke layers
require conf/rdke-config.inc

LINUXLIBCVERSION = "4.9%"

#Machine overrides
MACHINEOVERRIDES .= ":arm"
MACHINEOVERRIDES .= ":kirkstone"
MACHINEOVERRIDES .= ":client:rdkzram"

#Distro features
DISTRO_FEATURES:append = " systemd"

DISTRO_FEATURES_BACKFILL_CONSIDERED += "sysvinit"
VIRTUAL-RUNTIME_init_manager ?= "systemd"
VIRTUAL-RUNTIME_initscripts ?= "systemd-compat-units"

#OSS includes
include conf/machine/include/oss.inc
include conf/include/oss-config.inc

#ptest include
include ${@bb.utils.contains('DISTRO_FEATURES', 'ptest', 'conf/machine/include/ptest.inc', '', d)}
```

## conf/machine/rdk-cortexa15.conf
```bitbake
#TYPE: Machine
#@NAME: rdk-cortexa15hf
#@NEEDED_BSPLAYERS: rdke/common/meta-oss-reference-development
#@DESCRIPTION: rdk cortexa15hf arch specific oss machine
#

DEFAULTTUNE = "cortexa15hf-neon"

require conf/machine/include/arm/armv7a/tune-cortexa15.inc

# configs shared across rdke layers
require conf/rdke-config.inc

LINUXLIBCVERSION = "5.16%"

#Machine overrides
MACHINEOVERRIDES .= ":arm"
MACHINEOVERRIDES .= ":kirkstone"
MACHINEOVERRIDES .= ":broadband"

#Distro features
DISTRO_FEATURES:append = " systemd"

DISTRO_FEATURES_BACKFILL_CONSIDERED += "sysvinit"
VIRTUAL-RUNTIME_init_manager ?= "systemd"
VIRTUAL-RUNTIME_initscripts ?= "systemd-compat-units"

#OSS includes
include conf/machine/include/oss.inc
include conf/include/oss-config.inc

PREFERRED_VERSION_jsoncpp = "1:1.9.5"
PREFERRED_VERSION_dnsmasq = "2.83"
PREFERRED_VERSION_gettext-native = "0.21"
PREFERRED_VERSION_bluez5 = "5.66"
```

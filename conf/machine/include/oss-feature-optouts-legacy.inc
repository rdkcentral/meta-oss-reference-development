## conf/machine/include/oss-feature-optouts-legacy.inc
```bitbake
DISTRO_FEATURES_BACKFILL_CONSIDERED += "pulseaudio"
DISTRO_FEATURES_BACKFILL_CONSIDERED += "gobject-introspection-data"
DISTRO_FEATURES_BACKFILL_CONSIDERED += "ldconfig"
```

## conf/machine/include/oss-feature-optouts-wrynose.inc
```bitbake
DISTRO_FEATURES_OPTED_OUT += "pulseaudio"
DISTRO_FEATURES_OPTED_OUT += "gobject-introspection-data"
DISTRO_FEATURES_OPTED_OUT += "ldconfig"
```
